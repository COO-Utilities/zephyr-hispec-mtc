## CMakeLists.txt
```
cmake_minimum_required(VERSION 3.20.0)

find_package(Zephyr REQUIRED HINTS $ENV{ZEPHYR_BASE})

project(mqtt_demo LANGUAGES C)

target_sources(app PRIVATE src/main.c)
```

## prj.conf
```kconfig
# Serial console
CONFIG_SERIAL=y
CONFIG_CONSOLE=y
CONFIG_UART_CONSOLE=y

# Increase main thread stack size for networking
CONFIG_MAIN_STACK_SIZE=4096

# Logging
CONFIG_LOG=y
CONFIG_LOG_DEFAULT_LEVEL=3
CONFIG_LOG_BACKEND_UART=y
CONFIG_LOG_MODE_IMMEDIATE=y

# Network debug logging
CONFIG_NET_LOG=y
CONFIG_NET_DHCPV4_LOG_LEVEL_DBG=y

# Networking stack
CONFIG_NETWORKING=y
CONFIG_NET_IPV4=y
CONFIG_NET_TCP=y
CONFIG_NET_SOCKETS=y
CONFIG_POSIX_API=y

# Ethernet driver
CONFIG_NET_L2_ETHERNET=y
CONFIG_ETH_STM32_HAL=y
CONFIG_ETH_STM32_HAL_API_V2=y

# DNS for hostname resolution
CONFIG_DNS_RESOLVER=y

# DHCP client
CONFIG_NET_DHCPV4=y

# Network buffers
CONFIG_NET_PKT_RX_COUNT=16
CONFIG_NET_PKT_TX_COUNT=16
CONFIG_NET_BUF_RX_COUNT=32
CONFIG_NET_BUF_TX_COUNT=32
CONFIG_NET_MAX_CONTEXTS=10

# MQTT support
CONFIG_MQTT_LIB=y

# 5.0 is required, not optional: command_dispatch uses the publish properties
# (response_topic, correlation_data) that only exist in the v5 wire format.
CONFIG_MQTT_VERSION_5_0=y

# JSON parsing for the command dispatcher
CONFIG_JSON_LIBRARY=y
CONFIG_JSON_LIBRARY_FP_SUPPORT=y

# Console subsystem backs the dispatcher's serial command duals
CONFIG_CONSOLE_SUBSYS=y
CONFIG_CONSOLE_GETCHAR=y
CONFIG_CONSOLE_GETCHAR_BUFSIZE=128

# NVS-backed settings persistence, so configuration survives a power cycle
CONFIG_FLASH=y
CONFIG_FLASH_PAGE_LAYOUT=y
CONFIG_FLASH_MAP=y
CONFIG_NVS=y
CONFIG_MPU_ALLOW_FLASH_WRITE=y

CONFIG_COO_JSON=y

# Briefly reject MQTT effect commands after local serial activity, so a bench
# operator and the ICS cannot drive the controller against each other
CONFIG_COO_CMD_SERIAL_GUARD=y
CONFIG_COO_CMD_SERIAL_GUARD_DEFAULT_SECONDS=30

# COO libraries
CONFIG_COO_COMMONS=y
CONFIG_COO_MQTT=y
CONFIG_COO_MQTT_BROKER_HOSTNAME="centaurus.caltech.edu"
CONFIG_COO_MQTT_BROKER_PORT="1883"
```

## boards/nucleo_h563zi.overlay
```dts
/*
 * Devicetree overlay for NUCLEO-H563ZI
 */

/* Empty overlay - Ethernet PHY is already configured in board DTS */
```

## src/main.c
```c
/*
 * Copyright (c) 2025 Caltech Optical Observatories
 * SPDX-License-Identifier: Apache-2.0
 *
 * MQTT Demo - demonstrates using the coo_mqtt client library
 */

#include <zephyr/kernel.h>
#include <zephyr/logging/log.h>
#include <zephyr/net/net_if.h>
#include <zephyr/net/net_core.h>
#include <zephyr/net/net_context.h>
#include <zephyr/net/net_mgmt.h>
#include <zephyr/net/dhcpv4.h>
#include <coo_commons/mqtt_client.h>
#include <string.h>

LOG_MODULE_REGISTER(mqtt_demo, LOG_LEVEL_DBG);

/* MQTT client instance */
static struct mqtt_client client;

/* Topics */
#define TOPIC_CMD    "coo/demo/cmd"
#define TOPIC_STATUS "coo/demo/status"

/* Message ID for publishing */
static uint16_t pub_msg_id = 1;

/**
 * Publish a message to a topic
 */
static int publish(const char *topic, const char *payload)
{
	struct mqtt_publish_param param;

	param.message.topic.qos = MQTT_QOS_0_AT_MOST_ONCE;
	param.message.topic.topic.utf8 = topic;
	param.message.topic.topic.size = strlen(topic);
	param.message.payload.data = (uint8_t *)payload;
	param.message.payload.len = strlen(payload);
	param.message_id = pub_msg_id++;
	param.dup_flag = 0;
	param.retain_flag = 0;

	return mqtt_publish(&client, &param);
}

/**
 * Callback for received MQTT messages
 */
static void on_message(const struct mqtt_publish_param *pub, void *user_data)
{
	ARG_UNUSED(user_data);
	const char *topic = pub->message.topic.topic.utf8;
	const char *payload = pub->message.payload.data;
	size_t topic_len = pub->message.topic.topic.size;
	size_t payload_len = pub->message.payload.len;

	LOG_INF("Received: topic='%.*s' payload='%.*s'",
		(int)topic_len, topic, (int)payload_len, payload);

	/* Echo back on status topic */
	char response[128];
	snprintf(response, sizeof(response), "ACK: %.*s", (int)payload_len, payload);
	publish(TOPIC_STATUS, response);
}

/**
 * Wait for network interface to be ready
 * Supports both DHCP (CONFIG_NET_DHCPV4) and static IP (CONFIG_NET_CONFIG_SETTINGS)
 */
static void wait_for_network(void)
{
	struct net_if *iface = net_if_get_default();
	int wait_count = 0;

	LOG_INF("Waiting for network interface...");

	/* Wait for interface to be up */
	while (!net_if_is_up(iface)) {
		if (wait_count % 10 == 0) {
			LOG_INF("Interface not up yet... (%d s)", wait_count / 10);
		}
		k_msleep(100);
		wait_count++;
	}
	LOG_INF("Network interface is up");

#if defined(CONFIG_NET_DHCPV4)
	/* DHCP mode: start client and wait for address */
	LOG_INF("Starting DHCP client...");
	net_dhcpv4_start(iface);

	wait_count = 0;
	LOG_INF("Waiting for DHCP...");
	while (true) {
		struct net_if_ipv4 *ipv4 = iface->config.ip.ipv4;
		if (ipv4 && ipv4->unicast[0].ipv4.is_used) {
			char addr_str[NET_IPV4_ADDR_LEN];
			net_addr_ntop(AF_INET, &ipv4->unicast[0].ipv4.address.in_addr,
				      addr_str, sizeof(addr_str));
			LOG_INF("Got IP address: %s", addr_str);
			break;
		}
		if (wait_count % 2 == 0) {
			LOG_INF("Waiting for DHCP... (%d s)", wait_count / 2);
		}
		k_msleep(500);
		wait_count++;
	}
#else
	/* Static IP mode: address is configured at boot via CONFIG_NET_CONFIG_* */
	/* Just wait briefly for the stack to be ready */
	k_msleep(100);

	struct net_if_ipv4 *ipv4 = iface->config.ip.ipv4;
	if (ipv4 && ipv4->unicast[0].ipv4.is_used) {
		char addr_str[NET_IPV4_ADDR_LEN];
		net_addr_ntop(AF_INET, &ipv4->unicast[0].ipv4.address.in_addr,
			      addr_str, sizeof(addr_str));
		LOG_INF("Using static IP: %s", addr_str);
	} else {
		LOG_WRN("No IP address configured");
	}
#endif
}

int main(void)
{
	int rc;

	LOG_INF("MQTT Demo starting");

	/* Wait for network connectivity */
	wait_for_network();

	/* Initialize MQTT client */
	rc = coo_mqtt_init(&client, "coo-mqtt-demo");
	if (rc != 0) {
		LOG_ERR("Failed to initialize MQTT client: %d", rc);
		return rc;
	}

	/* Set up subscription and callback */
	coo_mqtt_add_subscription(TOPIC_CMD, MQTT_QOS_0_AT_MOST_ONCE);
	coo_mqtt_set_message_callback(on_message, NULL);

	/* Connect to broker (blocks until connected) */
	LOG_INF("Connecting to MQTT broker...");
	coo_mqtt_connect(&client);

	/* Publish startup message */
	publish(TOPIC_STATUS, "online");

	/* Run MQTT event loop (blocks) */
	LOG_INF("Entering MQTT event loop");
	coo_mqtt_run(&client);

	LOG_INF("MQTT Demo exiting");
	return 0;
}
```
