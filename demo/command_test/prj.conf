## CMakeLists.txt
```
cmake_minimum_required(VERSION 3.20.0)

find_package(Zephyr REQUIRED HINTS $ENV{ZEPHYR_BASE})

project(command_test LANGUAGES C)

target_sources(app PRIVATE src/main.c)
```

## prj.conf
```kconfig
CONFIG_LOG=y
CONFIG_CBPRINTF_FP_SUPPORT=y
CONFIG_MAIN_STACK_SIZE=4096

CONFIG_SERIAL=y
CONFIG_CONSOLE=y
CONFIG_UART_CONSOLE=y

CONFIG_SPI=y
CONFIG_I2C=y
CONFIG_ADC=y
CONFIG_REGULATOR=y
CONFIG_REGULATOR_TPS55287Q1=y

# command_dispatch pulls in MQTT + NVS + JSON; networking is required to link it
CONFIG_NETWORKING=y
CONFIG_NET_IPV4=y
CONFIG_NET_TCP=y
CONFIG_NET_SOCKETS=y
CONFIG_NET_L2_ETHERNET=y
CONFIG_ETH_STM32_HAL=y
CONFIG_MQTT_LIB=y
CONFIG_MQTT_VERSION_5_0=y
CONFIG_JSON_LIBRARY=y
CONFIG_JSON_LIBRARY_FP_SUPPORT=y
CONFIG_CONSOLE_SUBSYS=y
CONFIG_CONSOLE_GETCHAR=y
CONFIG_FLASH=y
CONFIG_FLASH_MAP=y
CONFIG_NVS=y
CONFIG_MPU_ALLOW_FLASH_WRITE=y

CONFIG_COO_CONFIG_LIB=y
CONFIG_COO_SENSORS_LIB=y
CONFIG_COO_HEATERS_LIB=y
CONFIG_COO_CONTROL_LIB=y
CONFIG_COO_COMMONS=y
CONFIG_COO_MQTT=y
CONFIG_COO_JSON=y
CONFIG_COO_COMMANDS_LIB=y
```

## src/main.c
```c
/* Exercise the thermal command table without MQTT: dispatch a sequence of
 * requests locally and print each response. */

#include <string.h>
#include <stdio.h>

#include <zephyr/kernel.h>
#include <zephyr/logging/log.h>

#include <config.h>
#include <control_loop.h>
#include <sensor_manager.h>
#include <heater_manager.h>
#include <thermal_commands.h>

LOG_MODULE_REGISTER(command_test, LOG_LEVEL_INF);

static void run(const char *key, const char *payload)
{
	struct coo_cmd_request cmd = {0};
	struct coo_cmd_response out = {0};

	strncpy(cmd.key, key, sizeof(cmd.key) - 1);
	if (payload != NULL) {
		strncpy(cmd.payload, payload, sizeof(cmd.payload) - 1);
		cmd.payload_len = strlen(cmd.payload);
	}

	thermal_commands_dispatch(&cmd, &out);
	printf("%-24s %-22s -> %.*s\n", key, payload ? payload : "(query)",
	       (int)out.payload_len, out.payload);
}

int main(void)
{
	thermal_config_t *config = config_load_defaults();

	if (config == NULL) {
		LOG_ERR("config_load_defaults failed");
		return 0;
	}
	control_loop_init(config);
	sensor_manager_init(config);
	heater_manager_init(config);

	printf("=== thermal command dispatch ===\n");
	run("loops", NULL);
	run("sensors", NULL);
	run("heaters", NULL);
	run("loop/loop-1/target", "{\"value\":25.0}");
	run("loop/loop-1/target", NULL);
	run("loop/loop-1/gains", "{\"kp\":8.0,\"ki\":0.2,\"kd\":1.5}");
	run("loop/loop-1/gains", NULL);
	run("loop/loop-1/enable", "{\"value\":false}");
	run("loop/loop-1/enable", NULL);
	run("loop/loop-1/status", NULL);
	run("loop/nope/target", NULL);
	run("estop", "{}");
	run("bogus", NULL);
	printf("=== done ===\n");

	return 0;
}
```
