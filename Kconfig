## Kconfig
```kconfig
menu "zephyr-hispec-mtc"

rsource "drivers/Kconfig"
rsource "lib/Kconfig"

endmenu
```

## drivers/heater/Kconfig
```kconfig
menuconfig HEATER
    bool "Heater drivers"
    default n
    help
        Include heater drivers in system config

if HEATER

module = HEATER
module-str = heater
source "subsys/logging/Kconfig.template.log_config"

rsource "tps55287q1/Kconfig"

endif # HEATER
```

## drivers/heater/tps55287q1/Kconfig
```kconfig
menuconfig TPS55287Q1
    bool "TPS55287-Q1 36V, 4A Buck-Boost Converter"
    default n
    depends on I2C
    help
        Enable driver for the TPS55287-Q1 36V, 4A Buck-Boost Converter. This driver depends on the I2C subsystem being enabled.

if TPS55287Q1

config TPS55287Q1_INIT_PRIORITY
    int "TPS55287-Q1 initialization priority"
    default 70
    depends on TPS55287Q1
    help
      Set initialization priority for TPS55287-Q1 driver.

config TPS55287Q1_LOG_LEVEL
    int "TPS55287-Q1 driver log level"
    default 3
    depends on TPS55287Q1
    help
      Set log level for TPS55287Q1 driver (0=off, 1=err, 2=wrn, 3=inf, 4=dbug)

endif # TPS55287Q1
```

## drivers/regulator/tps55287q1/Kconfig
```kconfig
config REGULATOR_TPS55287Q1
    bool "TI TPS55287-Q1 buck-boost regulator"
    depends on DT_HAS_TI_TPS55287Q1_ENABLED && I2C && REGULATOR
    help
      Enable support for the TI TPS55287-Q1 36-V, 4-A synchronous
      buck-boost converter with I2C interface, exposed as a regulator
      using the Zephyr regulator API.
    
config REGULATOR_TPS55287Q1_INIT_PRIORITY
    int "TPS55287-Q1 init priority"
    depends on REGULATOR_TPS55287Q1
    default 70
    help
      Initialization priority for TPS55287-Q1 regulator driver.

config REGULATOR_TPS55287Q1_LOG_LEVEL
    int "TPS55287Q1 driver log level"
    depends on REGULATOR_TPS55287Q1
    default 3
    range 0 4
    help
      Set log level for TPS55287-Q1 regulator driver.
      0 = OFF
      1 = ERROR
      2 = WARNING
      3 = INFO
      4 = DEBUG
```

## dts/bindings/heater/ti,tps55287q1.yaml
```yaml
description: TI TPS55287-Q1 36V, 4A Buck-Boost Converter
compatible: ti,tps55287q1
include: i2c-device.yaml

properties:
  reg:
    required: true
    description: I2C Address (0x74 or 0x75 depending on MODE pin wiring)
```

## dts/bindings/regulator/ti,tps55287q1.yaml
```yaml
title: TI TPS55287-Q1 buck-boost regulator

description: |
  Texas Instruments TPS55287-Q1 Automotive 36V 4A buck-boost converter with I²C interface.

compatible: "ti,tps55287q1"

include:
  - name: i2c-device.yaml
  - name: regulator.yaml

on-bus: i2c

properties:
  reg:
      required: true
      
  intfb:
    type: int
    required: false
    default: 3
    enum:
      - 0
      - 1
      - 2
      - 3
    description: |
      Internal feedback ratio (INTFB[1:0] bits in VOUT_FS register, 04h).

      0: 0.2256  -> VOUT range 0.8 V .. 5 V,   ~2.5 mV step
      1: 0.1128  -> VOUT range 0.8 V .. 10 V,  ~5 mV step
      2: 0.0752  -> VOUT range 0.8 V .. 15 V,  ~7.5 mV step
      3: 0.0564  -> VOUT range 0.8 V .. 20 V,  ~10 mV step (datasheet default)

      The driver uses this to translate between VOUT (microvolts) and the REF DAC code in registers 00h/01h.
```

## lib/Kconfig
```kconfig
menu "COO Custom libraries"

rsource "coo_commons/Kconfig"
rsource "config/Kconfig"
rsource "heaters/Kconfig"
rsource "sensors/Kconfig"
rsource "control/Kconfig"
rsource "commands/Kconfig"

endmenu
```

## lib/commands/Kconfig
```kconfig
config COO_COMMANDS_LIB
    bool "COO Thermal command table"
    depends on COO_CONTROL_LIB && COO_SENSORS_LIB && COO_HEATERS_LIB
    depends on COO_MQTT && COO_JSON
    help
      Thermal controller MQTT/serial command table: registers the ICD command
      handlers against the coo_commons command dispatcher.
```

## lib/config/Kconfig
```kconfig
config COO_CONFIG_LIB
    bool "COO Config Library"
    default y
    help
      Enable the COO Thermal Controller Configuration library.

config COO_MAX_SENSORS
    int "Maximum number of sensors"
    default 100
    depends on COO_CONFIG_LIB
    help
      Maximum number of sensors the system can manage.

config COO_MAX_HEATERS
    int "Maximum number of heaters"
    default 20
    depends on COO_CONFIG_LIB
    help
      Maximum number of heaters the system can manage.

config COO_MAX_CONTROL_LOOPS
    int "Maximum number of control loops"
    default 8
    depends on COO_CONFIG_LIB
    help
      Maximum number of independent PID control loops.

config COO_MAX_SENSORS_PER_LOOP
    int "Maximum sensors per control loop"
    default 20
    depends on COO_CONFIG_LIB
    help
      Maximum number of sensors that can feed into a single control loop.

config COO_MAX_HEATERS_PER_LOOP
    int "Maximum heaters per control loop"
    default 4
    depends on COO_CONFIG_LIB
    help
      Maximum number of heaters driven by a single control loop.
```

## lib/control/Kconfig
```kconfig
config COO_CONTROL_LIB
    bool "COO Control Library"
    default y
    depends on COO_CONFIG_LIB
    help
      Enable the COO Thermal Controller Control Loop library.
```

## lib/heaters/Kconfig
```kconfig
config COO_HEATERS_LIB
    bool "COO Heaters Library"
    default y
    depends on COO_CONFIG_LIB
    help
      Enable the COO Thermal Controller Heater Manager library.
```

## lib/sensors/Kconfig
```kconfig
config COO_SENSORS_LIB
    bool "COO Sensors Library"
    default y
    depends on COO_CONFIG_LIB
    help
      Enable the COO Thermal Controller Sensor Manager library.

config COO_ADC_TEMP_SENSOR
    bool "AD7124 internal temperature sensor driver"
    default n
    depends on COO_SENSORS_LIB && SPI
    help
      Raw-SPI driver for the AD7124 on-die temperature sensor. Requires a
      devicetree node labelled "ad7124". Off by default because that node is
      not present in every build.
```

## west.yml
```yaml
manifest:
  self:
    west-commands: scripts/west-commands.yml

  remotes:
    - name: zephyrproject-rtos
      url-base: https://github.com/zephyrproject-rtos

  projects:
    - name: zephyr
      remote: zephyrproject-rtos
      # Pinned rather than tracking main: coo_commons needs >= 4.4 for
      # zephyr/kvss/nvs.h and console_set_rx_timeout(), and a floating
      # revision makes CI non-reproducible.
      revision: v4.4.0
      import:
        name-allowlist:
          - hal_stm32  # required by the nucleo_h563zi board (STM32 based)
          - cmsis_6    # required by Cortex-M cores (ARM architecture)
```
